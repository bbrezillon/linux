## Documentation/devicetree/bindings/clock/xlnx,clk-wizard.txt
```
Device Tree Clock bindings for the "Clocking Wizard" IP provided by Xilinx

This block can be used to generate up to 4 clock signals out of a single input
clock. It embeds a PLL to generate an intermediate clock which then feeds 4
clock dividers whose divider value can be adjusted based on the user needs.

Required properties:
 - #clock-cells: must be 1. The cell is encoding the id of the output clk
		 (from 0 to xlnx,clk-wizard-num-outputs - 1)
 - compatible: must be "xlnx,clk-wizard-5.1"
 - clocks: 2 clocks are required
 - clock-names: should contain 2 clock names: "aclk" and "clkin".
		"aclk" is driving the register interface and "clk_in" is the
		input clock signal that is used by the PLL block
 - xlnx,clk-wizard-num-outputs: this describe the number of output clocks
				(chosen at synthesization time)
 - reg: registers used to configure the Clocking wizard block

Example:

	clkwizard: clkwizard@43c20000 {
		compatible = "xlnx,clk-wizard-5.1";
		reg = <0x43c20000 0x10000>;
		clocks = <&clkc 18>, <&clkc 18>;
		clock-names = "aclk", "clk_in1";
		#clock-cells = <1>;
		xlnx,clk-wizard-num-outputs = <2>;
	};
```

## Documentation/devicetree/bindings/display/panel/toshiba,lt089ac29000.txt
```
Toshiba 8.9" WXGA (1280x768) TFT LCD panel

Required properties:
- compatible: should be one of the following
	      "toshiba,lt089ac29000"
	      "toshiba,lta089ac29000"

- power-supply: as specified in the base binding

This binding is compatible with the simple-panel binding, which is specified
in simple-panel.txt in this directory.
```

## Documentation/devicetree/bindings/gpio/gpio-cdns-i3c.txt
```
* Cadence I3C GPIO expander

The Cadence I3C GPIO expander provides 8 GPIOs controllable over I3C.
This GPIOs can be configured in output or input mode and if they are in input
mode they can generate IBIs (In Band Interrupts).

Required properties for GPIO node:
- reg : 3 cells encoding the I3C static address (none in our case) and the I3C
	Provisional ID. See Documentation/devicetree/bindings/i3c/i3c.txt for
	more details.
	Should be <0x0 0x392 0x0>.
- gpio-controller : Marks the device node as a gpio controller.
- #gpio-cells : Should be two. The first cell is the pin number and
  the second cell is used to specify the gpio polarity (GPIO_ACTIVE_HIGH or
  GPIO_ACTIVE_LOW)
- interrupt-controller: Marks the device node as an interrupt controller.
- #interrupt-cells : Should be 2. The first cell is the GPIO number.
  The second cell is used to specify trigger type and level flags.
  The following trigger types are accepted (see
  <dt-bindings/interrupt-controller/irq.h> for their definition):
	IRQ_TYPE_EDGE_RISING
	IRQ_TYPE_EDGE_FALLING
	IRQ_TYPE_EDGE_BOTH
	IRQ_TYPE_LEVEL_HIGH
	IRQ_TYPE_LEVEL_LOW

Example:

	i3c-master@xxx {
		...
		i3c_gpio_expander: gpio@0,39200000000 {
			reg = <0 0x392 0x0>;
			gpio-controller;
			#gpio-cells = <2>;
			interrupt-controller;
			#interrupt-cells = <2>;
		};
		...
	};
```

## Documentation/devicetree/bindings/i2c/google,cros-ec-i2c-tunnel.yaml
```yaml
# SPDX-License-Identifier: (GPL-2.0-only OR BSD-2-Clause)
%YAML 1.2
---
$id: http://devicetree.org/schemas/i2c/google,cros-ec-i2c-tunnel.yaml#
$schema: http://devicetree.org/meta-schemas/core.yaml#

title: I2C bus that tunnels through the ChromeOS EC (cros-ec)

maintainers:
  - Benson Leung <bleung@chromium.org>
  - Enric Balletbo i Serra <enric.balletbo@collabora.com>

description: |
  On some ChromeOS board designs we've got a connection to the EC (embedded
  controller) but no direct connection to some devices on the other side of
  the EC (like a battery and PMIC). To get access to those devices we need
  to tunnel our i2c commands through the EC.
  The node for this device should be under a cros-ec node like google,cros-ec-spi
  or google,cros-ec-i2c.

allOf:
  - $ref: /schemas/i2c/i2c-controller.yaml#

properties:
  compatible:
    const:
      google,cros-ec-i2c-tunnel

  google,remote-bus:
    $ref: "/schemas/types.yaml#/definitions/uint32"
    description: The EC bus we'd like to talk to.

  "#address-cells": true
  "#size-cells": true

patternProperties:
  "^.*@[0-9a-f]+$":
    type: object
    description: One node per I2C device connected to the tunnelled I2C bus.

additionalProperties: false

required:
  - compatible
  - google,remote-bus

examples:
  - |
    spi0 {
        #address-cells = <1>;
        #size-cells = <0>;
        cros-ec@0 {
            compatible = "google,cros-ec-spi";
            reg = <0>;

            i2c-tunnel {
                compatible = "google,cros-ec-i2c-tunnel";
                #address-cells = <1>;
                #size-cells = <0>;
                google,remote-bus = <0>;

                battery: battery@b {
                    compatible = "sbs,sbs-battery";
                    reg = <0xb>;
                    sbs,poll-retry-count = <1>;
                };
            };
        };
    };
```

## Documentation/devicetree/bindings/media/imx8m-vpu.txt
```
device-tree bindings for Hantro G1/G2/H1 VPU codecs implemented on i.MX8M SoCs

Required properties:
- compatible: value should be one of the following
		"nxp,imx8mq-vpu",
		"nxp,imx8mm-vpu";
- regs: VPU core and control block register ranges
- reg-names: should be
		"g1", "g2", "ctrl" on i.MX8MQ,
		"g1", "g2", "h1", "ctrl" on i.MX8MM.
- interrupts: encoding and decoding interrupt specifiers
- interrupt-names: should be
		"g1", "g2" on i.MX8MQ,
		"g1", "g2", "h1" on i.MX8MM.
- clocks: phandle to VPU core clocks and bus clock
- clock-names: should be
		"g1", "g2", "bus" on i.MX8MQ,
		"g1", "g2", "h1", "bus" on i.MX8MM.
- power-domains: phandle to power domain node

Examples:

	vpu: vpu@38300000 {
		compatible = "nxp,imx8mq-vpu";
		reg = <0x38300000 0x10000>,
		      <0x38310000 0x10000>,
		      <0x38320000 0x10000>;
		reg-names = "g1", "g2", "ctrl";
		interrupts = <GIC_SPI 7 IRQ_TYPE_LEVEL_HIGH>,
			     <GIC_SPI 8 IRQ_TYPE_LEVEL_HIGH>;
		interrupt-names = "g1", "g2";
		clocks = <&clk IMX8MQ_CLK_VPU_G1_ROOT>,
			 <&clk IMX8MQ_CLK_VPU_G2_ROOT>,
			 <&clk IMX8MQ_CLK_VPU_DEC_ROOT>;
		clock-names = "g1", "g2", "bus";
		power-domains = <&pgc_vpu>;
	};

	vpu: vpu@38300000 {
		compatible = "nxp,imx8mm-vpu";
		reg = <0x38300000 0x10000>,
		      <0x38310000 0x10000>,
		      <0x38320000 0x10000>;
		      <0x38330000 0x10000>;
		reg-names = "g1", "g2", "h1", "ctrl";
		interrupts = <GIC_SPI 7 IRQ_TYPE_LEVEL_HIGH>,
			     <GIC_SPI 8 IRQ_TYPE_LEVEL_HIGH>;
			     <GIC_SPI 9 IRQ_TYPE_LEVEL_HIGH>;
		interrupt-names = "g1", "g2", "h1";
		clocks = <&clk IMX8MQ_CLK_VPU_G1_ROOT>,
			 <&clk IMX8MQ_CLK_VPU_G2_ROOT>,
			 <&clk IMX8MQ_CLK_VPU_H1_ROOT>,
			 <&clk IMX8MQ_CLK_VPU_DEC_ROOT>;
		clock-names = "g1", "g2", "h1", "bus";
		power-domains = <&pgc_vpu>;
	};
```

## Documentation/devicetree/bindings/mtd/spi-nand.txt
```
SPI NAND flash

Required properties:
- compatible: should be "spi-nand"
- reg: should encode the chip-select line used to access the NAND chip

Optional properties
- spi-max-frequency: maximum frequency of the SPI bus the chip can operate at.
		     This should encode board limitations (i.e. max freq can't
		     be achieved due to crosstalk on IO lines).
		     When unspecified, the driver assumes the chip can run at
		     the max frequency defined in the spec (information
		     extracted chip detection time).
- spi-tx-bus-width: The bus width (number of data wires) that is used for MOSI.
		    Only encodes the board constraints (i.e. when not all IO
		    signals are routed on the board). Device constraints are
		    extracted when detecting the chip, and controller
		    constraints are exposed by the SPI mem controller. If this
		    property is missing that means no constraint at the board
		    level.
- spi-rx-bus-width: The bus width (number of data wires) that is used for MISO.
		    Only encodes the board constraints (i.e. when not all IO
		    signals are routed on the board). Device constraints are
		    extracted when detecting the chip, and controller
		    constraints are exposed by the SPI mem controller. If this
		    property is missing that means no constraint at the board
		    level.
```

## Documentation/devicetree/bindings/power/rockchip,power-controller.yaml
```yaml
# SPDX-License-Identifier: (GPL-2.0-only OR BSD-2-Clause)
%YAML 1.2
---
$id: http://devicetree.org/schemas/power/rockchip,power-controller.yaml#
$schema: http://devicetree.org/meta-schemas/core.yaml#

title: Rockchip Power Domains

maintainers:
  - Caesar Wang <wxt@rock-chips.com>
  - Heiko Stuebner <heiko@sntech.de>

description: |
  Rockchip processors include support for multiple power domains which can be
  powered up/down by software based on different application scenes to save power.

  Power domains contained within power-controller node are generic power domain
  providers documented in Documentation/devicetree/bindings/power/power-domain.yaml.

  IP cores belonging to a power domain should contain a 'power-domains'
  property that is a phandle for the power domain node representing the domain.

properties:
  power-controller:
    type: object
    description: List of power domains provided by this controller.

    properties:
      compatible:
        enum:
          - rockchip,px30-power-controller
          - rockchip,rk3036-power-controller
          - rockchip,rk3066-power-controller
          - rockchip,rk3128-power-controller
          - rockchip,rk3188-power-controller
          - rockchip,rk3228-power-controller
          - rockchip,rk3288-power-controller
          - rockchip,rk3328-power-controller
          - rockchip,rk3366-power-controller
          - rockchip,rk3368-power-controller
          - rockchip,rk3399-power-controller

      reg:
        description: |
          Power domain index. Valid values are defined in:
          "include/dt-bindings/power/px30-power.h" - for PX30 type power domain.
          "include/dt-bindings/power/rk3036-power.h" - for RK3036 type power domain.
          "include/dt-bindings/power/rk3066-power.h" - for RK3066 type power domain.
          "include/dt-bindings/power/rk3128-power.h" - for RK3128 type power domain.
          "include/dt-bindings/power/rk3188-power.h" - for RK3188 type power domain.
          "include/dt-bindings/power/rk3228-power.h" - for RK3228 type power domain.
          "include/dt-bindings/power/rk3288-power.h" - for RK3288 type power domain.
          "include/dt-bindings/power/rk3328-power.h" - for RK3328 type power domain.
          "include/dt-bindings/power/rk3366-power.h" - for RK3366 type power domain.
          "include/dt-bindings/power/rk3368-power.h" - for RK3368 type power domain.
          "include/dt-bindings/power/rk3399-power.h" - for RK3399 type power domain.
        maxItems: 1

      clocks:
        description: |
          A number of phandles to clocks that need to be enabled while power domain
          switches state.
      pm_qos:
        description: |
          A number of phandles to qos blocks which need to be saved and restored
          while power domain switches state.

      power-supply: true

    required:
      - compatible
      - reg

additionalProperties: false

examples:
  - |
    #include <dt-bindings/clock/rk3399-cru.h>
    #include <dt-bindings/power/rk3399-power.h>

    soc {
        #address-cells = <2>;
        #size-cells = <2>;

        qos_iep: qos@ffa98000 {
            compatible = "syscon";
            reg = <0x0 0xffa98000 0x0 0x20>;
        };

        qos_rga_r: qos@ffab0000 {
            compatible = "syscon";
            reg = <0x0 0xffab0000 0x0 0x20>;
        };

        qos_rga_w: qos@ffab0080 {
            compatible = "syscon";
            reg = <0x0 0xffab0080 0x0 0x20>;
        };

        qos_video_m0: qos@ffab8000 {
            compatible = "syscon";
            reg = <0x0 0xffab8000 0x0 0x20>;
        };

        qos_video_m1_r: qos@ffac0000 {
            compatible = "syscon";
            reg = <0x0 0xffac0000 0x0 0x20>;
        };

        qos_video_m1_w: qos@ffac0080 {
            compatible = "syscon";
            reg = <0x0 0xffac0080 0x0 0x20>;
        };

        power-management@ff310000 {
            compatible = "rockchip,rk3399-pmu", "syscon", "simple-mfd";
            reg = <0x0 0xff310000 0x0 0x1000>;

            power-controller {
                compatible = "rockchip,rk3399-power-controller";
                #power-domain-cells = <1>;
                #address-cells = <1>;
                #size-cells = <0>;

                /* These power domains are grouped by VD_CENTER */
                pd_iep@RK3399_PD_IEP {
                    reg = <RK3399_PD_IEP>;
                    clocks = <&cru ACLK_IEP>,
                             <&cru HCLK_IEP>;
                    pm_qos = <&qos_iep>;
                };
                pd_rga@RK3399_PD_RGA {
                    reg = <RK3399_PD_RGA>;
                    clocks = <&cru ACLK_RGA>,
                             <&cru HCLK_RGA>;
                    pm_qos = <&qos_rga_r>,
                             <&qos_rga_w>;
                };
                pd_vcodec@RK3399_PD_VCODEC {
                    reg = <RK3399_PD_VCODEC>;
                    clocks = <&cru ACLK_VCODEC>,
                             <&cru HCLK_VCODEC>;
                    pm_qos = <&qos_video_m0>;
                };
                pd_vdu@RK3399_PD_VDU {
                    reg = <RK3399_PD_VDU>;
                    clocks = <&cru ACLK_VDU>,
                             <&cru HCLK_VDU>;
                    pm_qos = <&qos_video_m1_r>,
                             <&qos_video_m1_w>;
                };
            };
        };
    };
```
